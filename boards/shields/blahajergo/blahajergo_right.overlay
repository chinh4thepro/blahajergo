#include "blahajergo.dtsi"

/ {
    chosen {
        zmk,kscan = &kscan;
    };

    kscan: kscan {
        compatible = "zmk,kscan-gpio-matrix";
        diode-direction = "col2row";

        row-gpios
            = <&pro_micro 7 (GPIO_PULL_DOWN | GPIO_ACTIVE_HIGH)>
            , <&pro_micro 8 (GPIO_PULL_DOWN | GPIO_ACTIVE_HIGH)>
            , <&pro_micro 9 (GPIO_PULL_DOWN | GPIO_ACTIVE_HIGH)>
            , <&pro_micro 10 (GPIO_PULL_DOWN | GPIO_ACTIVE_HIGH)>
            , <&pro_micro 11 (GPIO_PULL_DOWN | GPIO_ACTIVE_HIGH)>
            ;

        col-gpios
            = <&pro_micro 1 GPIO_ACTIVE_HIGH>
            , <&pro_micro 2 GPIO_ACTIVE_HIGH>
            , <&pro_micro 12 GPIO_ACTIVE_HIGH>
            , <&pro_micro 15 GPIO_ACTIVE_HIGH>
            , <&pro_micro 14 GPIO_ACTIVE_HIGH>
            , <&pro_micro 13 GPIO_ACTIVE_HIGH>
            ;
    };
};

&default_transform {
    col-offset = <6>;
};
