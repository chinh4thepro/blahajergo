## boards/shields/blahajergo/Kconfig.shield
```kconfig
config BLAHAJERGO_LEFT
    def_bool $(shields_list_contains,blahajergo_left)

config BLAHAJERGO_RIGHT
    def_bool $(shields_list_contains,blahajergo_right)
```

## config/boards/shields/blahajergo/Kconfig.defconfig
```kconfig
if BLAHAJERGO_LEFT

config ZMK_KEYBOARD_NAME
    default "blahajergo"

config ZMK_SPLIT_ROLE_CENTRAL
    default y

endif # Left

if BLAHAJERGO_LEFT || BLAHAJERGO_RIGHT

config ZMK_SPLIT
    default y

if ZMK_DISPLAY

config SSD1306
    default y

config I2C
    default y

endif # display

if LVGL # Light and Versatile Embedded Graphics Library

config LV_Z_VDB_size
    default 64

config LV_DPI_DEF
    default 148

config LV_Z_BITS_PER_PIXEL
    default 1

choice LV_COLOR_DEPTH
    default LV_COLOR_DEPTH_1
endchoice

endif # lvgl

endif # Left + Right
```
